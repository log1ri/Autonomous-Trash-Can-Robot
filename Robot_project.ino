#include <Adafruit_NeoPixel.h> 
#include <Adafruit_GFX.h>
#include <Adafruit_SSD1306.h>

//-----------------------------------------------OLED------------------------------------------------------------------------------
#define SCREEN_I2C_ADDR 0x3C // or 0x3C
#define SCREEN_WIDTH 128     // OLED display width, in pixels
#define SCREEN_HEIGHT 64     // OLED display height, in pixels
#define OLED_RST_PIN -1      // Reset pin (-1 if not available)

Adafruit_SSD1306 display(128, 64, &Wire, OLED_RST_PIN);

#define FRAME_DELAY (42)
#define FRAME_WIDTH (64)
#define FRAME_HEIGHT (64)
#define FRAME_COUNT (sizeof(frames) / sizeof(frames[0]))
int frame = 0;

// --------------------------------------------ultra_sonic------------------------------------------------------------------------
#define ECHO 7
#define TRIG 8 
// ---------------------------------------------------ir--------------------------------------------------------------------------
#define ir_L 5
#define ir_R 6
// ---------------------------------------------servo motor-----------------------------------------------------------------------
#define servo 9 
//-----------------------------------------------LED------------------------------------------------------------------------------
#define PIN            3  // ปรับให้ตรงกับหมายเลขพินที่คุณเชื่อมต่อกับแถบ LED
#define NUMPIXELS      16  // ปรับจำนวนพิกเซลของแถบ LED
Adafruit_NeoPixel strip = Adafruit_NeoPixel(NUMPIXELS, PIN, NEO_GRB + NEO_KHZ800);


//--------------------------------------------------BIN---------------------------------------------------------------------------
const byte PROGMEM frames[][512] = {
  {0,0,0,0,0,0,0,0,0,0,0,0,0,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0,0},
  {0,0,0,0,0,0,0,0,0,0,0,0,0,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0,0},
  {0,0,0,0,0,0,0,0,0,0,0,0,0,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0,0},
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  {0,0,0,0,0,0,0,0,0,0,0,0,0,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0,0}
};


// motor
int pwmA = 10;
int pwmB = 11;
int enA = 12;
int enB = 13;
int buz = 4;

long Distance =0;

void setup() {
  Serial.begin(9600);

  pinMode(pwmA, OUTPUT);
  pinMode(pwmB, OUTPUT);
  pinMode(enA, OUTPUT);
  pinMode(enB, OUTPUT);
  pinMode(buz, OUTPUT);

  pinMode(ECHO, INPUT);
  pinMode(TRIG, OUTPUT);

  pinMode(servo, OUTPUT);

  pinMode(ir_L, INPUT);
  pinMode(ir_R, INPUT);

  strip.begin();
  strip.show(); // set all pixel to black

  display.begin(SSD1306_SWITCHCAPVCC, SCREEN_I2C_ADDR);
}
  

void loop() {
  Distance = Distance_test();
  //read_Distance();
  //int sensorValue = digitalRead(ir_R);
  //Serial.println(sensorValue);
  if(Distance < 10){
    stop();
    servo_on();
    led_on();
   // delay(2000);
    bin();
  //   display.clearDisplay();
  // display.drawBitmap(32, 0, frames[frame], FRAME_WIDTH, FRAME_HEIGHT, 1);
  // display.display();
  // frame = (frame + 1) % FRAME_COUNT;
  // delay(FRAME_DELAY);
  }
      
  else {
    servo_off();
    led_off();
    if (!(digitalRead(ir_L)) && !(digitalRead(ir_R)))    // Move Forward
    {   
        forward();
    }
    if (!(digitalRead(ir_L)) && digitalRead(ir_R))    // Turn RIGHT
    {  
       right();
    }

    if (digitalRead(ir_L) && !(digitalRead(ir_R)))    // turn LEFT
    {  
      left();
    }
    
    // else (digitalRead(ir_L) && digitalRead(ir_R))    // stop
    // {
    //   stop();
    // }
 
  }

}



void forward(){
    digitalWrite(enA, LOW); //right
    digitalWrite(enB, HIGH);//right
    analogWrite(pwmA, 80);
    analogWrite(pwmB, 120);
}

void stop(){
    digitalWrite(enA, LOW); //right
    digitalWrite(enB, HIGH);//right
    analogWrite(pwmA, 0);
    analogWrite(pwmB, 0);
}
void left(){
    digitalWrite(enA, LOW); //right
    digitalWrite(enB, HIGH);//right
    analogWrite(pwmA, 90);
    analogWrite(pwmB, 0);
}
void right(){
  digitalWrite(enA, LOW); //right
    digitalWrite(enB, HIGH);//right
    analogWrite(pwmA, 0);
    analogWrite(pwmB, 90);
}

long Distance_test() {
  long duration;
  digitalWrite(TRIG, LOW);
  delayMicroseconds(2);
  digitalWrite(TRIG, HIGH);
  delayMicroseconds(10);
  digitalWrite(TRIG, LOW);

  duration = pulseIn(ECHO, HIGH);
  return (duration / 2) / 29.1;
}

void read_Distance() {
  Serial.print("Distance = ");
  Serial.print(Distance);
  Serial.println("cm");
}

void servo_off(){
  digitalWrite(servo, HIGH);
  delayMicroseconds(1000); // 1 ms
  digitalWrite(servo, LOW);
  delay(20);
}
void servo_on(){
  digitalWrite(servo, HIGH);
  delayMicroseconds(1500); // เริ่มจาก 2 ms และเพิ่มขึ้นถ้าจำเป็น
  digitalWrite(servo, LOW);
  delay(20);
}

void led_on(){
   for(int i=0; i<strip.numPixels(); i++) {
    strip.setPixelColor(i, strip.Color(255, 0, 0)); // ตั้งค่าพิกเซลที่ i เป็นสีแดง
    strip.show();
    }
}
void led_off(){
    for(int i=0; i<strip.numPixels(); i++) {
    strip.setPixelColor(i, strip.Color(0, 255, 0)); // ตั้งค่าพิกเซลที่ i เป็นสีแดง
    strip.show();
    }
}

void bin(){
  display.clearDisplay();
  display.drawBitmap(32, 0, frames[frame], FRAME_WIDTH, FRAME_HEIGHT, 1);
  display.display();
  frame = (frame + 1) % FRAME_COUNT;
  delay(FRAME_DELAY);
}